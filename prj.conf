## CMakeLists.txt
```
cmake_minimum_required(VERSION 3.20.0)

find_package(Zephyr REQUIRED HINTS $ENV{ZEPHYR_BASE})

project(rp2040 LANGUAGES C CXX)

target_sources(app PRIVATE src/main.cpp)
```

## prj.conf
```kconfig
# Enable C++ Language Support
CONFIG_CPLUSPLUS=y

# Link against the C++ Standard Library
CONFIG_LIB_CPLUSPLUS=y

# Enable Symmetric Multi-Processing support, which allows
# threads to be scheduled across multiple physical processors
CONFIG_SMP=y

# Use the new "Switch" thread switching code, which is required by SMP
CONFIG_USE_SWITCH=y

# Enable the serial/UART subsystem
CONFIG_SERIAL=y

CONFIG_LOG=n

CONFIG_DEBUG=y

CONFIG_NO_OPTIMIZATIONS=y

#CONFIG_USERSPACE=y

CONFIG_ASSERT=y

CONFIG_STACK_SENTINEL=y

CONFIG_EXTRA_EXCEPTION_INFO=y

CONFIG_DEBUG_INFO=y

CONFIG_EXCEPTION_STACK_TRACE=y

# Hard to use Semihosting in SMP on Cortex-M0 since it has no way to detect if the
# debugger is _actually_ attached. This causes the core to hard-fault if it calls a BKPT instruction
#CONFIG_SEMIHOST=y

# Enable the semihosting console
#CONFIG_SEMIHOST_CONSOLE=y

CONFIG_CONSOLE=y

# Disable the UART console driver, which is selected automatically with CONFIG_SERIAL=y
CONFIG_UART_CONSOLE=y

CONFIG_PRINTK=y

CONFIG_THREAD_NAME=y

CONFIG_THREAD_MONITOR=y

CONFIG_THREAD_ANALYZER=y

CONFIG_HWINFO=y
```

## src/main.cpp
```c
#include <zephyr/zephyr.h>
#include <zephyr/drivers/hwinfo.h>

void primary_thread_entry(void* a, void* b, void* c);
void second_thread_entry(void* a, void* b, void* c);
void tertiary_thread_entry(void* a, void* b, void* c);

K_THREAD_DEFINE(
    primary_thread, 
    4096,
    primary_thread_entry,
    NULL,
    NULL, 
    NULL,
    6,
    0,
    0
);

K_THREAD_DEFINE(
    second_thread, 
    4096,
    second_thread_entry,
    NULL,
    NULL, 
    NULL,
    6,
    0,
    0
);

K_THREAD_DEFINE(
    tertiary_thread, 
    4096,
    tertiary_thread_entry,
    NULL,
    NULL, 
    NULL,
    6,
    0,
    0
);

int main() {
    printk("MAIN THREAD RUN, CPU %d\n", arch_proc_id());
    return 0;
}

static inline void printf_hex(uint8_t* buff, size_t len) {
    static const size_t per_line = 10;
    for (size_t i = 0; i < len; i++) {
        printk("%x ", buff[i]);

        // Last char for this line
        if (i !=0 && i % per_line == 0) {
            printk("\n");
        }
    }

    // Extra newline at the end
    printk("\n");
}

void primary_thread_entry(void* a, void* b, void* c) {
    static uint8_t id[256];
    while(true) {
        k_msleep(15000);
        size_t len = hwinfo_get_device_id(id, 256);
        printk("Device Serial Number: ");
        printf_hex(id, len);
    }
}

void second_thread_entry(void* a, void* b, void* c) {
    while(true) {
        printk("Hello world from secondary thread, CPU %d!\n", arch_proc_id());
        k_msleep(300);
    }
}

void tertiary_thread_entry(void* a, void* b, void* c) {
    while(true) {
        printk("Hello world from tertiary thread, CPU %d\n", arch_proc_id());
        k_msleep(200);
    }
}
```
